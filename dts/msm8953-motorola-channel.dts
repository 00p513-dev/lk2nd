// SPDX-License-Identifier: GPL-2.0-only

/dts-v1/;

/include/ "msm8953.dtsi"

/ {
	// This is used by the bootloader to find the correct DTB
	qcom,msm-id = <349 0x0>;
	qcom,board-id = <0x49 0xA100>;
	qcom,msm-name = "SDM632";

	model = "Motorola Moto G7 Play";
	compatible = "motorola,channel", "qcom,msm8953", "lk2nd,device";
};
